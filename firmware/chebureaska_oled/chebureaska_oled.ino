// Пример GyverOLED. Смотри документацию на http://alexgyver.ru/gyveroled/
// вывод картинки из памяти, буфер не используем

// битмап из программы BITmaper OLED (ищи в папке с библиотекой)
const uint8_t cheburashka[] PROGMEM = {
  0x80, 0xE0, 0xF8, 0xA8, 0xFC, 0xD8, 0x78, 0xD0, 0xFC, 0x54, 0xFE, 0x0A, 0xAE, 0x66, 0x8A, 0x66, 0x8C, 0xE8, 0x1C, 0xF4, 0xFE, 0x6C, 0xF8, 0xC0, 
  0x0A, 0x7F, 0xEE, 0xBB, 0xEE, 0xBB, 0xEF, 0x3D, 0x77, 0x5F, 0xF4, 0xC9, 0xB3, 0xC9, 0x92, 0x6C, 0x11, 0x2B, 0x74, 0x7F, 0x57, 0x7D, 0x1F, 0x02, 
  0x00, 0x00, 0x01, 0x01, 0x02, 0x01, 0x00, 0x00, 0xF8, 0xDF, 0x77, 0xFE, 0xD9, 0x72, 0xD4, 0x0B, 0x1F, 0x1C, 0x28, 0x10, 0x00, 0x00, 0x00, 0x00, 
  0x00, 0x00, 0x00, 0x00, 0x00, 0x00, 0x00, 0x00, 0x1E, 0x1F, 0x1B, 0x0D, 0x17, 0x0F, 0x0B, 0x0E, 0x0F, 0x00, 0x00, 0x00, 0x00, 0x00, 0x00, 0x00, 
};

const uint8_t larisca[] PROGMEM = {
  0x02, 0x06, 0x06, 0x0D, 0x0A, 0x1F, 0x2C, 0x1B, 0x6E, 0xEE, 0xA2, 0x7C, 0xD4, 0x68, 0x00, 0x08, 0x00, 0x00, 0x00, 
  0x00, 0x00, 0x00, 0x00, 0x00, 0x00, 0x00, 0x00, 0x58, 0xFF, 0xD6, 0xBD, 0x77, 0x0D, 0x00, 0x00, 0x00, 0x00, 0x00, 
  0x00, 0x00, 0x00, 0x00, 0x00, 0x00, 0x00, 0x00, 0x01, 0x16, 0x3F, 0x15, 0x3F, 0x14, 0x18, 0x14, 0x0C, 0x08, 0x00, 
};

const uint8_t icon[] PROGMEM = {
  0x00, 0xF0, 0x00, 0x00, 0x80, 0x60, 0xF0, 0x00, 0x00, 0xF0, 0x10, 0x10,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 0x00, 
  0x00, 0x0F, 0x06, 0x01, 0x00, 0x00, 0x0F, 0x00, 0x00, 0x0F, 0x00, 0x00,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 0x00, 
  0x00, 0x00, 0x00, 0x00, 0x00, 0x00, 0x00, 0x00, 0x00, 0x00, 0x00, 0x00,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 0x00, 
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  0x00, 0x00, 0x00, 0x00, 0x00, 0x00, 0x00, 0x00, 0x00, 0x00, 0x00, 0x00,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 0x00, 
};

volatile int x_ch = 34;
volatile int y_la = 110;
unsigned long timer_la;
unsigned long timer_ch;
bool flag_po;
bool flag_ch;
bool flag_ch_2;
bool button;
int counter_pr;
int counter_st;

#define red_led 4
#define green_led 16

void btnIsr() {
  x_ch = 33;  
}


#include <GyverOLED.h>
GyverOLED<SSD1306_128x64, OLED_NO_BUFFER> oled;
// можно передать адрес: GyverOLED oled(0x3C);

void setup() {
  Serial.begin(9600);
  pinMode(23, INPUT_PULLUP);
  pinMode(red_led, OUTPUT);
  pinMode(green_led, OUTPUT);
  //attachInterrupt(23, btnIsr, RISING);
  oled.init();
  oled.clear();
  
  oled.drawBitmap(0, 0, icon, 128, 64);
  delay(5000);
  oled.clear();
  // вывод битмапа: (x, y, имя, размерХ, размерУ, инверсия INVERT или не указана)
  oled.drawBitmap(0, 34, cheburashka, 24, 29);
  oled.drawBitmap(110, 41, larisca, 19, 22);
  print_score();
}

void loop() {
  if (millis() - timer_la > 25){
    timer_la = millis(); 
    y_la--;
    if(y_la==24){
      //counter_pr++;
      if(x_ch==34){ 
        counter_st++;
        digitalWrite(red_led, HIGH);
        delay(50);
        digitalWrite(red_led, LOW);
      } else {
        digitalWrite(green_led, HIGH);
        delay(50);
        digitalWrite(green_led, LOW);
      }
      print_score();
    }
    if(y_la<-20){
      y_la=110;
      counter_pr++;
      /*if(x_ch==34){ 
        counter_st++;
        digitalWrite(red_led, HIGH);
        delay(50);
        digitalWrite(red_led, LOW);
      } else {
        digitalWrite(green_led, HIGH);
        delay(50);
        digitalWrite(green_led, LOW);
      }*/
    }
    //oled.clear();
    //print_score();
    print_figures();
    //oled.drawBitmap(y_la, 41, larisca, 19, 22);
  }
  if (x_ch<=33 && flag_ch==true){//millis() - timer_ch > 0 && 
    timer_ch=millis();
    //Serial.println("123");
    if(x_ch>0 && flag_ch_2){
      x_ch--;
    } else {
      flag_ch_2 = false;
      x_ch++;
      if(x_ch==34) flag_ch=false;
    }
    //oled.clear();
    //print_score();
    //print_figures();
    oled.drawBitmap(0, x_ch, cheburashka, 24, 29);
  }
  if(x_ch == 33 && flag_ch==false){ 
    Serial.println("456");
    //oled.clear();
    print_score();
    //print_figures();
    oled.drawBitmap(y_la, 41, larisca, 19, 22);
    timer_ch=millis();
    flag_ch = true;
    flag_ch_2 = true;
  }
  if(digitalRead(2)==!button) {
    Serial.println(digitalRead(2));
    x_ch = 33;  
    //print_figures;
    button=true;
  } else {
    Serial.println(digitalRead(2));
    button = false;
  }
}

void print_figures(){//функция отображения игрока и препятствия
  //oled.clear();
  oled.drawBitmap(0, x_ch, cheburashka, 24, 29);
  oled.drawBitmap(y_la, 41, larisca, 19, 22);
}

void print_score(){//функция отображения счёта
  oled.setCursor(25, 0);
  oled.print(String("Перепрыгнул:")+String(counter_pr-counter_st));
  oled.setCursor(43, 1);
  oled.print(String("Ударился:")+String(counter_st));
  oled.setCursor(61, 2);
  oled.print(String("Всего:")+String(counter_pr));
}
